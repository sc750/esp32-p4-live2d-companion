## user/Kconfig
```kconfig
menu "AI 对话服务配置（phase3）"

    config AI_LLM_BASE_URL
        string "LLM API base URL（OpenAI 兼容，不带 /chat/completions 尾巴）"
        default "https://api.deepseek.com"

    config AI_LLM_KEY
        string "LLM API Key"
        default ""   # 密钥不 defect 入库：填在 sdkconfig（已 gitignore）

    config AI_LLM_MODEL
        string "LLM 模型名"
        default "deepseek-flash"

    config AI_TTS_DOUBAO_URL
        string "豆包 TTS HTTP 单向流式 V3 端点"
        default "https://openspeech.bytedance.com/api/v3/tts/unidirectional"

    config AI_TTS_DOUBAO_APPID
        string "豆包 TTS App ID（空则不启用豆包后端）"
        default ""   # App ID 非密钥，但一并占位

    config AI_TTS_DOUBAO_KEY
        string "豆包 TTS Access Token（旧版控制台）或 API Key（新版）"
        default ""

    config AI_TTS_DOUBAO_VOICE
        string "豆包 TTS 音色 ID（如 zh_female_xxx / BV001_streaming）"
        default "BV001_streaming"

    config AI_TTS_DOUBAO_RESOURCE
        string "豆包 TTS 资源 ID（豆包语音合成 2.0 用 seed-tts-2.0）"
        default "seed-tts-2.0"

    config GW_URL
        string "语音网关 WS 地址（步骤 1 通道验证；ws://电脑IP:8765）"
        default "ws://10.56.204.52:8765"

    config GW_RECONNECT_MS
        int "语音网关断线重连间隔（毫秒）"
        default 5000
        range 1000 60000

    config AI_MIMO_BASE_URL
        string "小米 MiMo token plan base URL（MiMo ASR/TTS 用）"
        default "https://token-plan-cn.xiaomimimo.com/v1"

    config AI_MIMO_KEY
        string "小米 MiMo API Key"
        default ""

    config AI_TTS_MINIMAX_KEY
        string "MiniMax TTS API Key（非空则 TTS 走 MiniMax，否则用 MiMo）"
        default ""

    config AI_TTS_MINIMAX_URL
        string "MiniMax T2A v2 端点"
        default "https://api.minimaxi.com/v1/t2a_v2"

    config AI_TTS_MINIMAX_MODEL
        string "MiniMax TTS 模型（2.6-turbo 低延迟 / 2.8-hd 高音质）"
        default "speech-2.6-turbo"

    config AI_TTS_MINIMAX_VOICE
        string "MiniMax 音色 ID（中文女声）"
        default "female-shaonv"

    config ASR_XFYUN_APPID
        string "讯飞 APPID（非空则 ASR 走讯飞流式听写，否则用 MiMo）"
        default ""

    config ASR_XFYUN_APIKEY
        string "讯飞 APIKey（32 位）"
        default ""

    config ASR_XFYUN_APISECRET
        string "讯飞 APISecret（32 位）"
        default ""

    config AI_DIALOG_HISTORY_ROUNDS
        int "对话历史保留轮数（1 轮 = 一问一答）"
        default 10
        range 1 40

    config MUSIC_RADIO_URL_1
        string "网络电台 1 流地址（留空禁用；建议明文 http，不占 mbedTLS）"
        default "http://ice1.somafm.com/groovesalad-128-mp3"

    config MUSIC_RADIO_URL_2
        string "网络电台 2 流地址（留空禁用）"
        default "http://ice1.somafm.com/lush-128-mp3"

    config MUSIC_RADIO_URL_3
        string "网络电台 3 流地址（留空禁用）"
        default "http://ice1.somafm.com/dronezone-128-mp3"

endmenu
```

## user/Kconfig.projbuild
```kconfig
menu "BSP Wi-Fi 配置"

    config BSP_WIFI_SSID
        string "Wi-Fi SSID"
        default ""
        help
            目标 AP 名称。非空时 bsp_init_all 会在启动时自动连接。

    config BSP_WIFI_PASSWORD
        string "Wi-Fi 密码"
        default ""

endmenu
```
